## CMakeLists.txt
```
# SPDX-License-Identifier: Apache-2.0

cmake_minimum_required(VERSION 3.20.0)

find_package(Zephyr REQUIRED HINTS $ENV{ZEPHYR_BASE})
project(ghanode_unit)

set(APP_SRC ${CMAKE_CURRENT_SOURCE_DIR}/../../src)

target_include_directories(app PRIVATE ${APP_SRC})
target_sources(app PRIVATE
  src/test_backoff.c
  src/test_lux.c
  src/test_payload.c
  src/test_reading.c
  src/test_recovery.c
  src/test_timesync.c
  ${APP_SRC}/lux.c
  ${APP_SRC}/payload.c
  ${APP_SRC}/reading.c
  ${APP_SRC}/recovery.c
  ${APP_SRC}/timesync.c
)
```

## prj.conf
```kconfig
CONFIG_ZTEST=y
# %.1f in the JSON payload
CONFIG_PICOLIBC_IO_FLOAT=y
```

## src/test_backoff.c
```c
/*
 * SPDX-License-Identifier: Apache-2.0
 */

#include <zephyr/ztest.h>

#include "backoff.h"

ZTEST_SUITE(backoff, NULL, NULL, NULL, NULL, NULL);

ZTEST(backoff, test_doubles_up_to_the_cap)
{
	const uint32_t expected[] = {10000, 20000, 40000, 60000, 60000};
	uint32_t delay = 5000;

	for (size_t i = 0; i < ARRAY_SIZE(expected); i++) {
		delay = next_retry_delay(delay, 60000);
		zassert_equal(delay, expected[i], "step %zu: %u", i, delay);
	}
}

ZTEST(backoff, test_never_exceeds_the_cap)
{
	zassert_equal(next_retry_delay(40000, 60000), 60000);
	zassert_equal(next_retry_delay(60000, 60000), 60000);
}
```

## src/test_lux.c
```c
/*
 * SPDX-License-Identifier: Apache-2.0
 */

#include <zephyr/ztest.h>

#include "lux.h"

ZTEST_SUITE(lux, NULL, NULL, NULL, NULL, NULL);

ZTEST(lux, test_full_scale_is_dark)
{
	zassert_equal(ldr_volts_to_lux(3.3f), 0);
	zassert_equal(ldr_volts_to_lux(3.299f), 0);
}

ZTEST(lux, test_zero_volts_is_capped)
{
	zassert_equal(ldr_volts_to_lux(0.0f), LIGHT_LUX_MAX);
	zassert_equal(ldr_volts_to_lux(-0.1f), LIGHT_LUX_MAX);
}

/* At R10 (15 kOhm) the LDR reads 10 lux: V = 3.3 * 15000 / (15000 + 4700). */
ZTEST(lux, test_r10_reads_ten_lux)
{
	zassert_equal(ldr_volts_to_lux(3.3f * 15000.0f / 19700.0f), 10);
}

ZTEST(lux, test_more_light_lowers_the_voltage)
{
	zassert_true(ldr_volts_to_lux(1.0f) > ldr_volts_to_lux(2.0f));
	zassert_true(ldr_volts_to_lux(2.0f) > ldr_volts_to_lux(3.0f));
}

ZTEST(lux, test_near_zero_volts_is_capped)
{
	zassert_equal(ldr_volts_to_lux(0.0001f), LIGHT_LUX_MAX);
}
```

## src/test_payload.c
```c
/*
 * SPDX-License-Identifier: Apache-2.0
 */

#include <errno.h>
#include <stdio.h>
#include <string.h>

#include <zephyr/ztest.h>

#include "payload.h"

#define SENSOR_ID "8C65A319AC98"
/* 2026-11-04T12:55:00.999Z */
#define SAMPLE_EPOCH_MS 1793796900999LL

ZTEST_SUITE(payload, NULL, NULL, NULL, NULL, NULL);

/* The exact text the FreeRTOS node published. */
ZTEST(payload, test_matches_the_freertos_payload)
{
	const struct sensor_reading r = {
		.temperature_c = 23.44f,
		.humidity_pct = 47.2f,
		.light_lux = 767,
	};
	const char *expected = "{\"Sensor ID\": \"8C65A319AC98\", \"temperature\":23.4, "
			       "\"humidity\": 47, \"light\": 767}";
	char buf[208];
	const int n = payload_format(buf, sizeof(buf), SENSOR_ID, &r, NULL);

	zassert_equal(n, (int)strlen(expected));
	zassert_str_equal(buf, expected);
}

/* Once SNTP has synced, the sample time is appended in UTC, truncated to whole seconds. */
ZTEST(payload, test_timestamp_is_appended_in_utc)
{
	const struct sensor_reading r = {
		.temperature_c = 23.44f,
		.humidity_pct = 47.2f,
		.light_lux = 767,
	};
	const int64_t epoch_ms = SAMPLE_EPOCH_MS;
	const char *expected = "{\"Sensor ID\": \"8C65A319AC98\", \"temperature\":23.4, "
			       "\"humidity\": 47, \"light\": 767, "
			       "\"timestamp\": \"2026-11-04T12:55:00Z\"}";
	char buf[208];
	const int n = payload_format(buf, sizeof(buf), SENSOR_ID, &r, &epoch_ms);

	zassert_equal(n, (int)strlen(expected));
	zassert_str_equal(buf, expected);
}

static void assert_utc(int64_t epoch_s, const char *utc)
{
	const struct sensor_reading r = {0};
	const int64_t epoch_ms = epoch_s * 1000;
	char expected[48];
	char buf[208];

	snprintf(expected, sizeof(expected), "\"timestamp\": \"%s\"}", utc);
	zassert_true(payload_format(buf, sizeof(buf), SENSOR_ID, &r, &epoch_ms) > 0);
	zassert_not_null(strstr(buf, expected), "%s", buf);
}

/* Epoch start, a year end, a leap day, a non-leap century and the last four-digit year. */
ZTEST(payload, test_utc_calendar_edges)
{
	assert_utc(0, "1970-01-01T00:00:00Z");
	assert_utc(1735689599, "2024-12-31T23:59:59Z");
	assert_utc(1835481599, "2028-02-29T23:59:59Z");
	assert_utc(4107542400, "2100-03-01T00:00:00Z");
	assert_utc(253402300799, "9999-12-31T23:59:59Z");
}

ZTEST(payload, test_time_out_of_range_is_rejected)
{
	const struct sensor_reading r = {0};
	const int64_t before_1970 = -1;
	const int64_t after_9999 = 253402300800000LL;
	char buf[208];

	zassert_equal(payload_format(buf, sizeof(buf), SENSOR_ID, &r, &before_1970), -EINVAL);
	zassert_equal(payload_format(buf, sizeof(buf), SENSOR_ID, &r, &after_9999), -EINVAL);
}

ZTEST(payload, test_humidity_rounds_half_up)
{
	const struct sensor_reading r = {.temperature_c = 20.0f, .humidity_pct = 49.5f};
	char buf[208];

	zassert_true(payload_format(buf, sizeof(buf), SENSOR_ID, &r, NULL) > 0);
	zassert_not_null(strstr(buf, "\"humidity\": 50,"), "%s", buf);
}

ZTEST(payload, test_negative_temperature)
{
	const struct sensor_reading r = {.temperature_c = -3.24f, .humidity_pct = 0.4f};
	char buf[208];

	zassert_true(payload_format(buf, sizeof(buf), SENSOR_ID, &r, NULL) > 0);
	zassert_not_null(strstr(buf, "\"temperature\":-3.2,"), "%s", buf);
	zassert_not_null(strstr(buf, "\"humidity\": 0,"), "%s", buf);
}

ZTEST(payload, test_too_small_buffer_is_rejected)
{
	const struct sensor_reading r = {0};
	const int64_t epoch_ms = SAMPLE_EPOCH_MS;
	char buf[16];

	zassert_equal(payload_format(buf, sizeof(buf), SENSOR_ID, &r, NULL), -EMSGSIZE);
	zassert_equal(payload_format(buf, sizeof(buf), SENSOR_ID, &r, &epoch_ms), -EMSGSIZE);
}

/* The largest values the sensors can report still fit the MQTT payload buffer. */
ZTEST(payload, test_worst_case_fits)
{
	const struct sensor_reading r = {
		.temperature_c = -46.85f,
		.humidity_pct = 100.0f,
		.light_lux = 100000,
	};
	/* 2099-12-31T23:59:59Z */
	const int64_t epoch_ms = 4102444799000LL;
	char buf[208];

	zassert_true(payload_format(buf, sizeof(buf), "FFFFFFFFFFFF", &r, &epoch_ms) > 0);
}
```

## src/test_reading.c
```c
/*
 * SPDX-License-Identifier: Apache-2.0
 */

#include <zephyr/ztest.h>

#include "reading.h"

#define QUEUE_LEN 3

K_MSGQ_DEFINE(queue, sizeof(struct sensor_reading), QUEUE_LEN, 8);

static void purge_queue(void *fixture)
{
	ARG_UNUSED(fixture);
	k_msgq_purge(&queue);
}

static void put_n(int n)
{
	for (int i = 0; i < n; i++) {
		const struct sensor_reading r = {.uptime_ms = i};

		(void)reading_queue_put(&queue, &r);
	}
}

ZTEST_SUITE(reading_queue, NULL, NULL, purge_queue, NULL, NULL);

ZTEST(reading_queue, test_put_into_empty_queue_drops_nothing)
{
	const struct sensor_reading r = {.uptime_ms = 20000, .temperature_c = 21.0f};
	struct sensor_reading out;

	zassert_false(reading_queue_put(&queue, &r));
	zassert_ok(k_msgq_get(&queue, &out, K_NO_WAIT));
	zassert_equal(out.uptime_ms, 20000);
	zassert_equal(out.temperature_c, 21.0f);
}

ZTEST(reading_queue, test_readings_come_out_oldest_first)
{
	struct sensor_reading out;

	put_n(QUEUE_LEN);
	for (int i = 0; i < QUEUE_LEN; i++) {
		zassert_ok(k_msgq_get(&queue, &out, K_NO_WAIT));
		zassert_equal(out.uptime_ms, i);
	}
}

ZTEST(reading_queue, test_full_queue_drops_the_oldest)
{
	const struct sensor_reading newest = {.uptime_ms = 100};
	struct sensor_reading out;

	put_n(QUEUE_LEN);
	zassert_true(reading_queue_put(&queue, &newest));
	zassert_equal(k_msgq_num_used_get(&queue), QUEUE_LEN);

	zassert_ok(k_msgq_get(&queue, &out, K_NO_WAIT));
	zassert_equal(out.uptime_ms, 1);
	zassert_ok(k_msgq_get(&queue, &out, K_NO_WAIT));
	zassert_equal(out.uptime_ms, 2);
	zassert_ok(k_msgq_get(&queue, &out, K_NO_WAIT));
	zassert_equal(out.uptime_ms, 100);
}
```

## src/test_recovery.c
```c
/*
 * SPDX-License-Identifier: Apache-2.0
 */

#include <zephyr/ztest.h>

#include "recovery.h"

#define BOOT_MS     1000
#define IN_GRACE    (BOOT_MS + 60000)
#define AFTER_GRACE (BOOT_MS + RECOVERY_RESET_GRACE_MS)

static struct recovery r;

static void reset_ladder(void *fixture)
{
	ARG_UNUSED(fixture);
	recovery_init(&r, BOOT_MS);
}

ZTEST_SUITE(recovery, NULL, NULL, reset_ladder, NULL, NULL);

/* A broker that is down from boot only backs off; nothing has been recovered yet. */
ZTEST(recovery, test_connect_failures_from_boot_never_escalate)
{
	for (int i = 0; i < 10; i++) {
		zassert_equal(recovery_connect_failed(&r, AFTER_GRACE + i), RECOVERY_NONE);
	}
}

ZTEST(recovery, test_three_failed_connects_after_rejoin_reset_after_grace)
{
	recovery_wifi_rejoined(&r);

	zassert_equal(recovery_connect_failed(&r, AFTER_GRACE), RECOVERY_NONE);
	zassert_equal(recovery_connect_failed(&r, AFTER_GRACE), RECOVERY_NONE);
	zassert_equal(recovery_connect_failed(&r, AFTER_GRACE), RECOVERY_RESET_MCU);
}

/*
 * The 5 Nov board run: the access point came back, but the route to the broker
 * took minutes longer. Inside the grace period the node keeps retrying, so the
 * queue survives; once it is over, the next failure resets.
 */
ZTEST(recovery, test_failed_connects_after_rejoin_wait_out_the_grace_period)
{
	recovery_wifi_rejoined(&r);

	for (int i = 0; i < 10; i++) {
		zassert_equal(recovery_connect_failed(&r, IN_GRACE + i), RECOVERY_NONE);
	}
	zassert_equal(recovery_connect_failed(&r, AFTER_GRACE), RECOVERY_RESET_MCU);
}

ZTEST(recovery, test_dead_session_restarts_wifi_then_resets_after_grace)
{
	recovery_connected(&r);
	zassert_equal(recovery_session_ended(&r, false, true, IN_GRACE), RECOVERY_RESTART_WIFI);

	recovery_wifi_rejoined(&r);
	recovery_connected(&r);
	zassert_equal(recovery_session_ended(&r, false, true, IN_GRACE), RECOVERY_NONE);

	recovery_connected(&r);
	zassert_equal(recovery_session_ended(&r, false, true, AFTER_GRACE), RECOVERY_RESET_MCU);
}

/* A publish that got through proves the restart worked, so the ladder starts over. */
ZTEST(recovery, test_publish_resets_the_ladder)
{
	recovery_wifi_rejoined(&r);
	recovery_connected(&r);
	zassert_equal(recovery_session_ended(&r, true, true, AFTER_GRACE), RECOVERY_RESTART_WIFI);
}

/* The grace period counts from the last acknowledged publish, not from boot. */
ZTEST(recovery, test_publish_restarts_the_grace_period)
{
	const int64_t published_at = AFTER_GRACE;

	recovery_connected(&r);
	(void)recovery_session_ended(&r, true, false, published_at);

	recovery_wifi_rejoined(&r);
	for (int i = 0; i < RECOVERY_CONNECT_FAILS; i++) {
		zassert_equal(recovery_connect_failed(&r, published_at + 60000), RECOVERY_NONE);
	}
	zassert_equal(recovery_connect_failed(&r, published_at + RECOVERY_RESET_GRACE_MS),
		      RECOVERY_RESET_MCU);
}

ZTEST(recovery, test_clean_disconnect_does_not_escalate)
{
	recovery_wifi_rejoined(&r);
	recovery_connected(&r);
	zassert_equal(recovery_session_ended(&r, false, false, AFTER_GRACE), RECOVERY_NONE);
}

ZTEST(recovery, test_successful_connect_resets_the_fail_count)
{
	recovery_wifi_rejoined(&r);
	zassert_equal(recovery_connect_failed(&r, AFTER_GRACE), RECOVERY_NONE);
	zassert_equal(recovery_connect_failed(&r, AFTER_GRACE), RECOVERY_NONE);

	recovery_connected(&r);
	zassert_equal(recovery_session_ended(&r, false, false, AFTER_GRACE), RECOVERY_NONE);

	zassert_equal(recovery_connect_failed(&r, AFTER_GRACE), RECOVERY_NONE);
	zassert_equal(recovery_connect_failed(&r, AFTER_GRACE), RECOVERY_NONE);
	zassert_equal(recovery_connect_failed(&r, AFTER_GRACE), RECOVERY_RESET_MCU);
}
```

## src/test_timesync.c
```c
/*
 * SPDX-License-Identifier: Apache-2.0
 */

#include <errno.h>

#include <zephyr/ztest.h>

#include "timesync.h"

/* 2026-11-04T12:55:00Z */
#define SYNC_EPOCH_S  1793796900ULL
#define SYNC_EPOCH_MS 1793796900000LL
#define SYNC_UPTIME   600000LL
/* 0.5 s in NTP's 2^-32 s fractions */
#define HALF_SECOND   0x80000000U

ZTEST_SUITE(timesync, NULL, NULL, NULL, NULL, NULL);

ZTEST(timesync, test_no_time_before_the_first_sync)
{
	const struct timesync ts = {0};
	int64_t epoch_ms = 0;

	zassert_false(timesync_to_epoch_ms(&ts, SYNC_UPTIME, &epoch_ms));
}

ZTEST(timesync, test_implausible_answer_is_rejected)
{
	struct timesync ts = {0};
	int64_t epoch_ms = 0;

	zassert_equal(timesync_set(&ts, TIMESYNC_MIN_EPOCH_S - 1U, 0, SYNC_UPTIME, NULL),
		      -ERANGE);
	zassert_false(timesync_to_epoch_ms(&ts, SYNC_UPTIME, &epoch_ms));
}

ZTEST(timesync, test_fraction_becomes_milliseconds)
{
	struct timesync ts = {0};
	int64_t epoch_ms = 0;

	zassert_ok(timesync_set(&ts, SYNC_EPOCH_S, HALF_SECOND, SYNC_UPTIME, NULL));
	zassert_true(timesync_to_epoch_ms(&ts, SYNC_UPTIME, &epoch_ms));
	zassert_equal(epoch_ms, SYNC_EPOCH_MS + 500);
}

/* A reading queued during an outage, before the node got its first time. */
ZTEST(timesync, test_reading_taken_before_the_sync)
{
	struct timesync ts = {0};
	int64_t epoch_ms = 0;

	zassert_ok(timesync_set(&ts, SYNC_EPOCH_S, 0, SYNC_UPTIME, NULL));
	zassert_true(timesync_to_epoch_ms(&ts, SYNC_UPTIME - 20000, &epoch_ms));
	zassert_equal(epoch_ms, SYNC_EPOCH_MS - 20000);
}

ZTEST(timesync, test_reading_taken_after_the_sync)
{
	struct timesync ts = {0};
	int64_t epoch_ms = 0;

	zassert_ok(timesync_set(&ts, SYNC_EPOCH_S, 0, SYNC_UPTIME, NULL));
	zassert_true(timesync_to_epoch_ms(&ts, SYNC_UPTIME + 3600000, &epoch_ms));
	zassert_equal(epoch_ms, SYNC_EPOCH_MS + 3600000);
}

/* An hour later the local clock has drifted 250 ms; the resync reports and applies that. */
ZTEST(timesync, test_resync_reports_the_step)
{
	struct timesync ts = {0};
	int64_t step_ms = -1;
	int64_t epoch_ms = 0;

	zassert_ok(timesync_set(&ts, SYNC_EPOCH_S, 0, SYNC_UPTIME, &step_ms));
	zassert_equal(step_ms, 0);

	zassert_ok(timesync_set(&ts, SYNC_EPOCH_S + 3600U, 0, SYNC_UPTIME + 3599750, &step_ms));
	zassert_equal(step_ms, 250);
	zassert_true(timesync_to_epoch_ms(&ts, SYNC_UPTIME + 3599750, &epoch_ms));
	zassert_equal(epoch_ms, SYNC_EPOCH_MS + 3600000);
}

ZTEST(timesync, test_rejected_resync_keeps_the_previous_time)
{
	struct timesync ts = {0};
	int64_t epoch_ms = 0;

	zassert_ok(timesync_set(&ts, SYNC_EPOCH_S, 0, SYNC_UPTIME, NULL));
	zassert_equal(timesync_set(&ts, 0, 0, SYNC_UPTIME + 1000, NULL), -ERANGE);
	zassert_true(timesync_to_epoch_ms(&ts, SYNC_UPTIME, &epoch_ms));
	zassert_equal(epoch_ms, SYNC_EPOCH_MS);
}
```
